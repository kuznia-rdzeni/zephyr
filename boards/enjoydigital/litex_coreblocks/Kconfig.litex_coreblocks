## boards/enjoydigital/litex_coreblocks/Kconfig.litex_coreblocks
```kconfig
# Copyright (c) 2024 Piotr Wegrzyn (Kuznia Rdzeni)
# SPDX-License-Identifier: Apache-2.0

config BOARD_LITEX_COREBLOCKS
	select SOC_LITEX_COREBLOCKS
```

## boards/enjoydigital/litex_coreblocks/board.yml
```yaml
board:
  name: litex_coreblocks
  vendor: litex
  socs:
  - name: litex_coreblocks
```

## soc/litex/litex_coreblocks/Kconfig
```kconfig
# Copyright (c) 2024 Piotr Wegrzyn (Kuznia Rdzeni)
# SPDX-License-Identifier: Apache-2.0

config SOC_LITEX_COREBLOCKS
	select RISCV
	select INCLUDE_RESET_VECTOR
	select RISCV_ISA_RV32I
	select RISCV_ISA_EXT_ZICSR
	select RISCV_ISA_EXT_ZIFENCEI
	select ATOMIC_OPERATIONS_C

if SOC_LITEX_COREBLOCKS

config LITEX_CSR_DATA_WIDTH
	int "Select Control/Status register width"
	default 32

endif # SOC_LITEX_COREBLOCKS
```

## soc/litex/litex_coreblocks/Kconfig.defconfig
```kconfig
# Copyright (c) 2024 Piotr Wegrzyn (Kuznia Rdzeni)
# SPDX-License-Identifier: Apache-2.0

if SOC_LITEX_COREBLOCKS

config SYS_CLOCK_HW_CYCLES_PER_SEC
	default 50000000

config NUM_IRQS
	# Coreblocks uses hart-local interrupt controller:
	# NUM_IRQS include RISC-V reserved interrupts 0..15, but there are only 16 usable
	# interrupts (16..31)
	# Custom platform interrupts used by LiteX are remapped in DTS from 0..15 to 16..31 and are
	# consistent with LiteX numbering
	default 32

config REBOOT
	depends on DT_HAS_LITEX_SOC_CONTROLLER_ENABLED
	default y

endif # SOC_LITEX_COREBLOCKS
```

## soc/litex/litex_coreblocks/Kconfig.soc
```kconfig
# Copyright (c) 2024 Piotr Wegrzyn (Kuznia Rdzeni)
# SPDX-License-Identifier: Apache-2.0

config SOC_LITEX_COREBLOCKS
	bool
	help
	  LiteX Coreblocks system implementation

config SOC
	default "litex_coreblocks" if SOC_LITEX_COREBLOCKS
```
